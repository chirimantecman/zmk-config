/ {
    zephyr,display = &oled;
};

&oled {
    compatible = "ssd1306";
    spi-max-frequency = <10000000>;
    width = <128>;
    height = <32>;
    segment-offset = <0>;
    page-offset = <0>;
    display-offset = <0>;
    multiplex-ratio = <31>;
    reset-gpios = <&gpio0 10 GPIO_ACTIVE_LOW>;
};